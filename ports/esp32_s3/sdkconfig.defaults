## ports/esp32_s3/sdkconfig.defaults
```kconfig
# MMBasic Anywhere - ESP32-S3 sdkconfig defaults
#
# ESP32-S3 port defaults: USB console, flash/PSRAM, watchdog,
# WiFi, cores, and filesystem.

# --- Console ----------------------------------------------------------------
# Use the chip's built-in USB Serial/JTAG controller for stdio. Same USB-C
# cable handles flashing and console; no external UART adapter needed.
CONFIG_ESP_CONSOLE_USB_SERIAL_JTAG=y

# --- Flash + PSRAM ----------------------------------------------------------
# Keep the default image compatible with common ESP32-S3 modules. Larger
# 16 MB boards such as Metro/Freenove still run this layout.
CONFIG_ESPTOOLPY_FLASHSIZE_4MB=y
CONFIG_ESPTOOLPY_FLASHSIZE="4MB"

# The N16R8 board uses 8 MB Octal PSRAM. Enable it through ESP-IDF and
# keep it caps-only: port code may opt in with heap_caps_malloc(...,
# MALLOC_CAP_SPIRAM), but malloc()/AllMemory/PSRAMsize do not use it.
CONFIG_SPIRAM=y
CONFIG_SPIRAM_MODE_OCT=y
CONFIG_SPIRAM_TYPE_AUTO=y
CONFIG_SPIRAM_SPEED_80M=y
CONFIG_SPIRAM_BOOT_INIT=y
CONFIG_SPIRAM_IGNORE_NOTFOUND=y
CONFIG_SPIRAM_USE_CAPS_ALLOC=y
# CONFIG_SPIRAM_USE_MALLOC is not set
CONFIG_SPIRAM_MEMTEST=y
# Let ESP-IDF place WiFi/lwIP allocations in PSRAM first. USB host, VGA,
# task stacks, and DMA descriptors all compete for internal RAM.
CONFIG_SPIRAM_TRY_ALLOCATE_WIFI_LWIP=y

# --- Stack ------------------------------------------------------------------
# Keep enough stack for the BASIC parser/REPL, but do not burn 24 KB of scarce
# internal RAM before USB host and WiFi have started.
CONFIG_ESP_MAIN_TASK_STACK_SIZE=16384

# --- CPU --------------------------------------------------------------------
# Run the ESP32-S3 at the top supported application CPU clock by default.
CONFIG_ESP_DEFAULT_CPU_FREQ_MHZ_240=y
CONFIG_ESP_DEFAULT_CPU_FREQ_MHZ=240

# --- Compiler ---------------------------------------------------------------
# Use -O2 for the application image. The BASIC interpreter and bytecode bridge
# are branch-heavy enough that ESP-IDF's debug -Og default is not representative
# for performance comparisons.
CONFIG_COMPILER_OPTIMIZATION_PERF=y

# --- Watchdog ---------------------------------------------------------------
# Disable the task watchdog entirely. With it on (~5s default), long-running
# BASIC FOR loops would trip it and reboot. Hard requirement for any
# non-trivial BASIC program.
CONFIG_ESP_TASK_WDT_INIT=n

# --- Radios -----------------------------------------------------------------
# WiFi is used by the ESP32-native WEB/OPTION WIFI surface.
CONFIG_ESP_WIFI_ENABLED=y
CONFIG_ESP_WIFI_TASK_PINNED_TO_CORE_0=y
CONFIG_BT_ENABLED=n

# --- WiFi/lwIP coexistence ---------------------------------------------------
# The ESP32-S3 build has VGA DMA, USB host, audio, WiFi, and telnet in one
# ESP32-S3. Use a lower-throughput WiFi/lwIP profile so USB keyboard mode does
# not starve the internal/DMA heap.
CONFIG_ESP_WIFI_STATIC_RX_BUFFER_NUM=6
CONFIG_ESP_WIFI_DYNAMIC_RX_BUFFER_NUM=8
CONFIG_ESP_WIFI_STATIC_TX_BUFFER=y
# CONFIG_ESP_WIFI_DYNAMIC_TX_BUFFER is not set
CONFIG_ESP_WIFI_STATIC_TX_BUFFER_NUM=8
CONFIG_ESP_WIFI_CACHE_TX_BUFFER_NUM=8
CONFIG_ESP_WIFI_RX_MGMT_BUF_NUM_DEF=3
# CONFIG_ESP_WIFI_AMPDU_TX_ENABLED is not set
# CONFIG_ESP_WIFI_AMPDU_RX_ENABLED is not set
CONFIG_ESP_WIFI_MGMT_SBUF_NUM=8
# CONFIG_ESP_WIFI_ENABLE_WPA3_SAE is not set
# CONFIG_ESP_WIFI_ENABLE_SAE_PK is not set
# CONFIG_ESP_WIFI_SOFTAP_SAE_SUPPORT is not set
# CONFIG_ESP_WIFI_ENABLE_WPA3_OWE_STA is not set

CONFIG_LWIP_MAX_SOCKETS=6
CONFIG_LWIP_TCPIP_RECVMBOX_SIZE=16
# CONFIG_LWIP_IPV6 is not set
CONFIG_LWIP_MAX_ACTIVE_TCP=6
CONFIG_LWIP_MAX_LISTENING_TCP=4
CONFIG_LWIP_TCP_SND_BUF_DEFAULT=2880
CONFIG_LWIP_TCP_WND_DEFAULT=2880
# CONFIG_LWIP_TCP_QUEUE_OOSEQ is not set

# --- Cores ------------------------------------------------------------------
# Use both cores. MMBasic stays on one, but FreeRTOS housekeeping etc.
# benefits from the second.
CONFIG_FREERTOS_UNICORE=n

# --- Partition table + FATFS -----------------------------------------------
# Custom partition table: 2 MB app, internal LittleFS A:, and MMBasic
# option/flash-slot storage within a 4 MB flash image.
CONFIG_PARTITION_TABLE_CUSTOM=y
CONFIG_PARTITION_TABLE_CUSTOM_FILENAME="partitions.csv"
CONFIG_PARTITION_TABLE_FILENAME="partitions.csv"
CONFIG_FATFS_LFN_HEAP=y
CONFIG_FATFS_MAX_LFN=255
```

## ports/esp32_s3_metro/sdkconfig.defaults
```kconfig
# MMBasic Anywhere — Metro ESP32-S3 sdkconfig defaults
#
# ESP32-S3 Metro port defaults: USB console, flash/PSRAM, watchdog,
# WiFi, cores, and filesystem.

# --- Console ----------------------------------------------------------------
# Use the chip's built-in USB Serial/JTAG controller for stdio. Same USB-C
# cable handles flashing and console; no external UART adapter needed.
CONFIG_ESP_CONSOLE_USB_SERIAL_JTAG=y

# --- Flash + PSRAM ----------------------------------------------------------
# Adafruit Metro ESP32-S3 #5500 N16R8 module: 16 MB flash + 8 MB Embedded
# Octal PSRAM (AP_3v3, confirmed via esptool.py chip_id).
CONFIG_ESPTOOLPY_FLASHSIZE_16MB=y
CONFIG_ESPTOOLPY_FLASHSIZE="16MB"

# The N16R8 board uses 8 MB Octal PSRAM. Enable it through ESP-IDF and
# keep it caps-only: port code may opt in with heap_caps_malloc(...,
# MALLOC_CAP_SPIRAM), but malloc()/AllMemory/PSRAMsize do not use it.
CONFIG_SPIRAM=y
CONFIG_SPIRAM_MODE_OCT=y
CONFIG_SPIRAM_TYPE_AUTO=y
CONFIG_SPIRAM_SPEED_80M=y
CONFIG_SPIRAM_BOOT_INIT=y
CONFIG_SPIRAM_USE_CAPS_ALLOC=y
# CONFIG_SPIRAM_USE_MALLOC is not set
CONFIG_SPIRAM_MEMTEST=y

# --- Stack ------------------------------------------------------------------
# 24 KB main task stack. Phase A doesn't need this much, but Phase B
# will (recursive descent parser + setjmp/longjmp through deep BASIC
# nests). Setting it now avoids a config churn later.
CONFIG_ESP_MAIN_TASK_STACK_SIZE=24576

# --- Watchdog ---------------------------------------------------------------
# Disable the task watchdog entirely. With it on (~5s default), long-running
# BASIC FOR loops would trip it and reboot. Hard requirement for any
# non-trivial BASIC program.
CONFIG_ESP_TASK_WDT_INIT=n

# --- Radios -----------------------------------------------------------------
# WiFi is used by the ESP32-native WEB/OPTION WIFI surface.
CONFIG_ESP_WIFI_ENABLED=y
CONFIG_ESP_WIFI_TASK_PINNED_TO_CORE_0=y
CONFIG_BT_ENABLED=n

# --- Cores ------------------------------------------------------------------
# Use both cores. MMBasic stays on one, but FreeRTOS housekeeping etc.
# benefits from the second.
CONFIG_FREERTOS_UNICORE=n

# --- Partition table + FATFS -----------------------------------------------
# Custom partition table: 1 MB app + 14 MB wear-leveled FATFS for BASIC
# program storage / SAVE / LOAD / OPEN / etc. Mounted at /sd in app_main.
CONFIG_PARTITION_TABLE_CUSTOM=y
CONFIG_PARTITION_TABLE_CUSTOM_FILENAME="partitions.csv"
CONFIG_PARTITION_TABLE_FILENAME="partitions.csv"
CONFIG_FATFS_LFN_HEAP=y
CONFIG_FATFS_MAX_LFN=255
```
